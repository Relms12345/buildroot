## package/ifupdown/Config.in
```kconfig
config BR2_PACKAGE_IFUPDOWN
	bool "ifupdown"
	depends on BR2_USE_MMU # fork()
	depends on BR2_TOOLCHAIN_HEADERS_AT_LEAST_3_4 # iproute2
	select BR2_PACKAGE_IPROUTE2
	select BR2_PACKAGE_DEBIANUTILS
	help
	  High level tools to configure network interfaces.

	  https://tracker.debian.org/pkg/ifupdown

comment "ifupdown needs a toolchain w/ headers >= 3.4"
	depends on BR2_USE_MMU
	depends on !BR2_TOOLCHAIN_HEADERS_AT_LEAST_3_4
```

## package/which/Config.in
```kconfig
config BR2_PACKAGE_WHICH
	bool "which"
	help
	  The standard 'which' utility.

	  http://carlowood.github.io/which/index.html
```
